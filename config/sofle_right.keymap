#include "sofle_left.keymap"

    &kscan0 {
        compatible = "zmk,kscan-gpio-matrix";
        wakeup-source;
        diode-direction = "col2row";
        row-gpios =
            <&pro_micro 5 (GPIO_ACTIVE_HIGH | GPIO_PULL_DOWN)>,
            // [RA] override blown "&pro_micro 6" aka 100 aka D6 P1.00 pin with 101 aka P1.01.
            // https://docs.splitkb.com/product-guides/nice-nano/schematics-and-pinout
            <&gpio1 1 (GPIO_ACTIVE_HIGH | GPIO_PULL_DOWN)>,
            <&pro_micro 7 (GPIO_ACTIVE_HIGH | GPIO_PULL_DOWN)>,
            <&pro_micro 8 (GPIO_ACTIVE_HIGH | GPIO_PULL_DOWN)>,
            <&pro_micro 9 (GPIO_ACTIVE_HIGH | GPIO_PULL_DOWN)>;

        col-gpios =
            <&pro_micro 10 GPIO_ACTIVE_HIGH>,
            <&pro_micro 16 GPIO_ACTIVE_HIGH>,
            <&pro_micro 14 GPIO_ACTIVE_HIGH>,
            <&pro_micro 15 GPIO_ACTIVE_HIGH>,
            <&pro_micro 18 GPIO_ACTIVE_HIGH>,
            <&pro_micro 19 GPIO_ACTIVE_HIGH>;
    };

